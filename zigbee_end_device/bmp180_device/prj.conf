## CMakeLists.txt
```
cmake_minimum_required(VERSION 3.20.0)

set(BOARD_FLASH_RUNNER nrfutil)
find_package(Zephyr REQUIRED HINTS $ENV{ZEPHYR_BASE})

project(bmp180_device)

# NORDIC SDK APP START
target_sources(app PRIVATE
  src/main.c
  src/my_nrf52_timer.c
  src/bmp_180.c
  src/bmp180_math.c
  src/my_rtc.c
)

target_include_directories(app PRIVATE include)
# NORDIC SDK APP END
```

## Kconfig
```
# Copyright (c) 2026 Nordic Semiconductor ASA
# SPDX-License-Identifier: LicenseRef-Nordic-5-Clause

menu "Zephyr Kernel"
source "Kconfig.zephyr"
endmenu

config BMP180_DEVICE_TEST_MODE
	bool "Enable E2E test mode with mocked temperature output"
	default n
	help
	  When enabled, the BMP180 driver will return a sequence of mocked
	  temperature values instead of reading from the physical sensor via I2C.

config ZIGBEE_DEVELOPMENT_SECURITY
	bool "Enable ZBOSS security with a hardcoded static Install Code for development"
	default y
	help
	  When enabled, a pre-defined static EUI64 and Install Code will be registered
	  automatically at boot, facilitating testing without manual CLI/UART registration.

config ZIGBEE_RESET_PERSISTENT_CONFIG
	bool "Erase persistent configuration on boot"
	default y
	help
	  When enabled, persistent storage (network configuration) is erased on boot.
	  Disable this to allow network credentials and keys to persist across reboots.
```

## prj.conf
```kconfig
#
# Copyright (c) 2020 Nordic Semiconductor ASA
#
# SPDX-License-Identifier: LicenseRef-Nordic-5-Clause
#

CONFIG_NCS_SAMPLES_DEFAULTS=y

CONFIG_UART_INTERRUPT_DRIVEN=y
CONFIG_SERIAL=y
CONFIG_GPIO=y

# Enable / disable asserts
CONFIG_ASSERT=y

# Make sure printk is not printing to the UART console
CONFIG_CONSOLE=y
CONFIG_UART_CONSOLE=y
CONFIG_CONSOLE_GETLINE=y
CONFIG_CONSOLE_SUBSYS=y

CONFIG_HEAP_MEM_POOL_SIZE=2048

CONFIG_ZIGBEE=y
CONFIG_ZIGBEE_APP_UTILS=y
CONFIG_ZIGBEE_ROLE_END_DEVICE=y

# Enable DK LED and Buttons library
CONFIG_DK_LIBRARY=y

# Crypto drivers
CONFIG_CRYPTO=y
CONFIG_CRYPTO_NRF_ECB=y
CONFIG_CRYPTO_INIT_PRIORITY=80

# This example requires more workqueue stack
CONFIG_SYSTEM_WORKQUEUE_STACK_SIZE=2048

# Enable API for powering down unused RAM parts
CONFIG_RAM_POWER_DOWN_LIBRARY=y

# Networking
CONFIG_NET_IPV6=n
CONFIG_NET_IP_ADDR_CHECK=n
CONFIG_NET_UDP=n


CONFIG_I2C=y
CONFIG_SENSOR=y
```

## src/main.c
```c
/*
 * Copyright (c) 2020 Nordic Semiconductor ASA
 *
 * SPDX-License-Identifier: LicenseRef-Nordic-5-Clause
 */

/** @file
 * @brief Dimmer switch for HA profile implementation.
 */

#include <zephyr/kernel.h>
#include <zephyr/device.h>
#include <zephyr/logging/log.h>
#include <dk_buttons_and_leds.h>
#include <zephyr/console/console.h>
#include <string.h>
#include <zephyr/sys/reboot.h>
#include <ram_pwrdn.h>
#include <zephyr/random/random.h>

#include <zboss_api.h>
#include <zboss_api_addons.h>
#include <zigbee/zigbee_app_utils.h>
#include <zigbee/zigbee_error_handler.h>
#include <zb_nrf_platform.h>
#include "zb_mem_config_custom.h"
#include "bmp_180.h"
#include "my_nrf52_timer.h"
#include "my_rtc.h"
#include <zephyr/irq.h>

#if defined(CONFIG_LIGHT_SWITCH_CONFIGURE_TX_POWER)
#include <osif/mac_platform.h>
#endif

/* Source endpoint used to report temperature. */
#define BMP180_SENSOR_ENDPOINT      1

/* Do not erase NVRAM to save the network parameters after device reboot or
 * power-off. NOTE: If this option is set to ZB_TRUE then do full device erase
 * for all network devices before running other samples.
 */
#define ERASE_PERSISTENT_CONFIG    (IS_ENABLED(CONFIG_ZIGBEE_RESET_PERSISTENT_CONFIG) ? ZB_TRUE : ZB_FALSE)
/* LED indicating that light switch successfully joind Zigbee network. */
#define ZIGBEE_NETWORK_STATE_LED   DK_LED3

/* Button ID used to enable sleepy behavior. */
#define BUTTON_SLEEPY              DK_BTN3_MSK

/* Button to start Factory Reset */
#define FACTORY_RESET_BUTTON       DK_BTN4_MSK

#if !defined ZB_ED_ROLE
#error Define ZB_ED_ROLE to compile light switch (End Device) source code.
#endif

LOG_MODULE_REGISTER(app, LOG_LEVEL_INF);

/* True once the device has successfully joined the Zigbee network.
 * Temperature reports are suppressed until this is set to prevent
 * spurious ZCL write failures when not associated. */
static bool g_network_joined = false;

struct zb_device_ctx {
	zb_zcl_basic_attrs_t basic_attr;
	zb_zcl_identify_attrs_t identify_attr;
};

static struct zb_device_ctx dev_ctx;

/* Declare attribute list for Basic cluster (server). */
ZB_ZCL_DECLARE_BASIC_SERVER_ATTRIB_LIST(
	basic_server_attr_list,
	&dev_ctx.basic_attr.zcl_version,
	&dev_ctx.basic_attr.power_source);

/* Declare attribute list for Identify cluster (client). */
ZB_ZCL_DECLARE_IDENTIFY_CLIENT_ATTRIB_LIST(
	identify_client_attr_list);

/* Declare attribute list for Identify cluster (server). */
ZB_ZCL_DECLARE_IDENTIFY_SERVER_ATTRIB_LIST(
	identify_server_attr_list,
	&dev_ctx.identify_attr.identify_time);

/* Custom cluster list containing Temp Measurement client cluster */
zb_zcl_cluster_desc_t bmp180_sensor_clusters[] =
{
	ZB_ZCL_CLUSTER_DESC(
		ZB_ZCL_CLUSTER_ID_BASIC,
		ZB_ZCL_ARRAY_SIZE(basic_server_attr_list, zb_zcl_attr_t),
		(basic_server_attr_list),
		ZB_ZCL_CLUSTER_SERVER_ROLE,
		ZB_ZCL_MANUF_CODE_INVALID
	),
	ZB_ZCL_CLUSTER_DESC(
		ZB_ZCL_CLUSTER_ID_IDENTIFY,
		ZB_ZCL_ARRAY_SIZE(identify_server_attr_list, zb_zcl_attr_t),
		(identify_server_attr_list),
		ZB_ZCL_CLUSTER_SERVER_ROLE,
		ZB_ZCL_MANUF_CODE_INVALID
	),
	ZB_ZCL_CLUSTER_DESC(
		ZB_ZCL_CLUSTER_ID_IDENTIFY,
		ZB_ZCL_ARRAY_SIZE(identify_client_attr_list, zb_zcl_attr_t),
		(identify_client_attr_list),
		ZB_ZCL_CLUSTER_CLIENT_ROLE,
		ZB_ZCL_MANUF_CODE_INVALID
	),
	ZB_ZCL_CLUSTER_DESC(
		ZB_ZCL_CLUSTER_ID_TEMP_MEASUREMENT,
		0,
		NULL,
		ZB_ZCL_CLUSTER_CLIENT_ROLE,
		ZB_ZCL_MANUF_CODE_INVALID
	)
};

/* Custom simple descriptor with 2 IN and 2 OUT clusters */
ZB_DECLARE_SIMPLE_DESC(2, 2);
static ZB_AF_SIMPLE_DESC_TYPE(2, 2) simple_desc_bmp180_ep =
{
	BMP180_SENSOR_ENDPOINT,
	ZB_AF_HA_PROFILE_ID,
	0x0104, /* ZB_DIMMER_SWITCH_DEVICE_ID */
	0,      /* ZB_DEVICE_VER_DIMMER_SWITCH */
	0,
	2,
	2,
	{
		ZB_ZCL_CLUSTER_ID_BASIC,
		ZB_ZCL_CLUSTER_ID_IDENTIFY,
		ZB_ZCL_CLUSTER_ID_IDENTIFY,
		ZB_ZCL_CLUSTER_ID_TEMP_MEASUREMENT
	}
};

/* Bind custom cluster list to Endpoint */
ZB_AF_DECLARE_ENDPOINT_DESC(
	bmp180_sensor_ep,
	BMP180_SENSOR_ENDPOINT,
	ZB_AF_HA_PROFILE_ID,
	0,
	NULL,
	ZB_ZCL_ARRAY_SIZE(bmp180_sensor_clusters, zb_zcl_cluster_desc_t),
	bmp180_sensor_clusters,
	(zb_af_simple_desc_1_1_t *)&simple_desc_bmp180_ep,
	0, NULL,
	0, NULL
);

/* Declare application's device context (list of registered endpoints) */
ZBOSS_DECLARE_DEVICE_CTX_1_EP(bmp180_sensor_ctx, bmp180_sensor_ep);


/**@brief Starts identifying the device.
 *
 * @param  bufid  Unused parameter, required by ZBOSS scheduler API.
 */


static void write_attr_callback(zb_bufid_t bufid)
{
	zb_zcl_command_send_status_t *send_status = ZB_BUF_GET_PARAM(bufid, zb_zcl_command_send_status_t);
	if (send_status->status == RET_OK) {
		LOG_INF("Write attribute request sent successfully!");
	} else {
		LOG_ERR("Write attribute request failed to send: %d", send_status->status);
	}
	zb_buf_free(bufid);
}

static void send_temperature_cb(zb_bufid_t bufid)
{
    int32_t temp_raw;
    int err = bmp180_read_temperature(&temp_raw);

    if (err != 0) {
        LOG_ERR("Failed to read BMP180: %d", err);
        zb_buf_free(bufid);
        return;
    }

    zb_int16_t temp_zigbee = (zb_int16_t)(temp_raw);
    zb_uint8_t *ptr;

    ZB_ZCL_GENERAL_INIT_WRITE_ATTR_REQ(bufid, ptr, ZB_ZCL_ENABLE_DEFAULT_RESPONSE);

    ZB_ZCL_GENERAL_ADD_VALUE_WRITE_ATTR_REQ(
        ptr,
        ZB_ZCL_ATTR_TEMP_MEASUREMENT_VALUE_ID,
        ZB_ZCL_ATTR_TYPE_S16,
        (zb_uint8_t *)&temp_zigbee);
    
    zb_uint16_t coord_addr = 0x0000;
	
    ZB_ZCL_GENERAL_SEND_WRITE_ATTR_REQ(
        bufid,
        ptr,
        coord_addr,
        ZB_APS_ADDR_MODE_16_ENDP_PRESENT,
        10, /* ZIGBEE_COORDINATOR_ENDPOINT */
        BMP180_SENSOR_ENDPOINT,
        ZB_AF_HA_PROFILE_ID,
        ZB_ZCL_CLUSTER_ID_TEMP_MEASUREMENT,
        write_attr_callback);
}

/**@brief Callback for button events.
 *
 * @param[in]   button_state  Bitmask containing buttons state.
 * @param[in]   has_changed   Bitmask containing buttons that has
 *                            changed their state.
 */
static void button_handler(uint32_t button_state, uint32_t has_changed)
{
	/* Inform default signal handler about user input at the device. */
	user_input_indicate();

	check_factory_reset_button(button_state, has_changed);
}

/**@brief Function for initializing LEDs and Buttons. */
static void configure_gpio(void)
{
	int err;

	err = dk_buttons_init(button_handler);
	if (err) {
		LOG_ERR("Cannot init buttons (err: %d)", err);
	}

	err = dk_leds_init();
	if (err) {
		LOG_ERR("Cannot init LEDs (err: %d)", err);
	}
}

/**@brief Function for initializing all clusters attributes. */
static void app_clusters_attr_init(void)
{
	/* Basic cluster attributes data. */
	dev_ctx.basic_attr.zcl_version = ZB_ZCL_VERSION;
	dev_ctx.basic_attr.power_source = ZB_ZCL_BASIC_POWER_SOURCE_UNKNOWN;

	/* Identify cluster attributes data. */
	dev_ctx.identify_attr.identify_time = ZB_ZCL_IDENTIFY_IDENTIFY_TIME_DEFAULT_VALUE;
}

/**@brief Zigbee stack event handler.
 *
 * @param[in]   bufid   Reference to the Zigbee stack buffer
 *                      used to pass signal.
 */
#if !defined(CONFIG_ZIGBEE_DEVELOPMENT_SECURITY)
/* CRC-16/X-25 (reflected / Kermit variant) — same algorithm the ZBOSS
 * stack uses to validate Install Codes. */
static uint16_t ic_crc16_x25(const uint8_t *data, size_t len)
{
	uint16_t crc = 0xFFFF;
	for (size_t i = 0; i < len; i++) {
		crc ^= data[i];
		for (int b = 0; b < 8; b++) {
			crc = (crc & 1) ? (crc >> 1) ^ 0x8408 : (crc >> 1);
		}
	}
	return crc ^ 0xFFFF;
}

/* Generate a random Install Code (16 bytes + 2-byte CRC-16/X-25 LE)
 * and print the ready-to-paste UART commands for both devices. */
static void print_production_pairing_commands(void)
{
	zb_ieee_addr_t self_ieee;
	zb_get_long_address(self_ieee);

	uint8_t key[16];
	sys_rand_get(key, sizeof(key));

	uint16_t crc = ic_crc16_x25(key, sizeof(key));
	uint8_t ic[18];
	memcpy(ic, key, 16);
	ic[16] = (uint8_t)(crc & 0xFF);        /* CRC low byte */
	ic[17] = (uint8_t)((crc >> 8) & 0xFF); /* CRC high byte */

	/* Format IEEE address (big-endian display) */
	char ieee_str[17];
	snprintk(ieee_str, sizeof(ieee_str), "%02x%02x%02x%02x%02x%02x%02x%02x",
	         self_ieee[7], self_ieee[6], self_ieee[5], self_ieee[4],
	         self_ieee[3], self_ieee[2], self_ieee[1], self_ieee[0]);

	/* Format IC as 36-char hex string */
	char ic_str[37];
	for (int i = 0; i < 18; i++) {
		snprintk(&ic_str[i * 2], 3, "%02x", ic[i]);
	}

	printk("\n");
	printk("╔══════════════════════════════════════════════════╗\n");
	printk("║       PRODUCTION PAIRING — copy-paste commands  ║\n");
	printk("╠══════════════════════════════════════════════════╣\n");
	printk("║ Step 1 — Coordinator (/dev/ttyACM0):             ║\n");
	printk("║   ic_add %s %s  ║\n", ieee_str, ic_str);
	printk("║   expected reply: ic_add_success + steering_started\n");
	printk("╠══════════════════════════════════════════════════╣\n");
	printk("║ Step 2 — End Device (this terminal):             ║\n");
	printk("║   ic_set %s %s  ║\n", ieee_str, ic_str);
	printk("║   expected reply: ic_set_success                 ║\n");
	printk("╠══════════════════════════════════════════════════╣\n");
	printk("║ Step 3 — End Device (this terminal):             ║\n");
	printk("║   join                                           ║\n");
	printk("║   expected reply: join_started                   ║\n");
	printk("╚══════════════════════════════════════════════════╝\n");
	printk("\n");
}
#endif

#if defined(CONFIG_ZIGBEE_DEVELOPMENT_SECURITY)
static void setup_static_install_code(void)
{
	LOG_INF("Setting static development install code in active stack...");
	zb_uint8_t dev_install_code[18] = {
		0xff, 0xee, 0xdd, 0xcc, 0xbb, 0xaa, 0x99, 0x88,
		0x77, 0x66, 0x55, 0x44, 0x33, 0x22, 0x11, 0x00,
		0x52, 0x0d
	};

	zb_ret_t status = zb_secur_ic_set(ZB_IC_TYPE_128, dev_install_code);
	if (status != RET_OK) {
		LOG_ERR("Failed to set static install code: %d", status);
	} else {
		LOG_INF("Static development install code set successfully.");
	}
}
#endif


void zboss_signal_handler(zb_bufid_t bufid)
{
	zb_zdo_app_signal_hdr_t *sig_hndler = NULL;
	zb_zdo_app_signal_type_t sig = zb_get_app_signal(bufid, &sig_hndler);
	zb_ret_t status = ZB_GET_APP_SIGNAL_STATUS(bufid);

	/* Update network status LED. */
	zigbee_led_status_update(bufid, ZIGBEE_NETWORK_STATE_LED);

	switch (sig) {
	case ZB_BDB_SIGNAL_DEVICE_FIRST_START:
	case ZB_BDB_SIGNAL_DEVICE_REBOOT:
		#if defined(CONFIG_ZIGBEE_DEVELOPMENT_SECURITY)
		setup_static_install_code();
		if (sig == ZB_BDB_SIGNAL_DEVICE_REBOOT && status == RET_OK) {
			g_network_joined = true;
			dk_set_led_on(DK_LED4);
		}
		/* Let default handler trigger automatic network steering */
		ZB_ERROR_CHECK(zigbee_default_signal_handler(bufid));
		#else
		if (sig == ZB_BDB_SIGNAL_DEVICE_REBOOT) {
			if (status == RET_OK)
			{
				g_network_joined = true;
				dk_set_led_on(DK_LED4);
			}
			/* Secure rejoin / startup from persistent data */
			ZB_ERROR_CHECK(zigbee_default_signal_handler(bufid));
		} else {
			/* Production mode first boot: do NOT auto-join. Print ready-to-paste commands. */
			print_production_pairing_commands();
			zb_buf_free(bufid);
			return;
		}
		#endif
		break;

	case ZB_BDB_SIGNAL_STEERING:
		/* Call default signal handler. */
		ZB_ERROR_CHECK(zigbee_default_signal_handler(bufid));
		if (status == RET_OK) {
			g_network_joined = true;
			LOG_INF("Network joined successfully.");
			dk_set_led_on(DK_LED4);
		}
		break;

	case ZB_ZDO_SIGNAL_LEAVE:
		g_network_joined = false;
		dk_set_led_off(DK_LED4);
		ZB_ERROR_CHECK(zigbee_default_signal_handler(bufid));
		break;

	default:
		/* Call default signal handler. */
		ZB_ERROR_CHECK(zigbee_default_signal_handler(bufid));
		break;
	}

	if (bufid) {
		zb_buf_free(bufid);
	}
}


static struct k_work rtc_work;

static void zb_trigger_temp_report(zb_bufid_t param)
{
	ARG_UNUSED(param);
	if (!g_network_joined) {
		/* Not on network yet — skip silently */
		return;
	}
	zb_ret_t err = zb_buf_get_out_delayed(send_temperature_cb);
	if (err != RET_OK) {
		LOG_ERR("Failed to allocate ZBOSS buffer for temp report (err %d)", err);
	}
}

static void rtc_work_handler(struct k_work *work)
{
	ARG_UNUSED(work);
	ZB_SCHEDULE_APP_CALLBACK(zb_trigger_temp_report, 0);
}

static void rtc2_isr(const void *arg)
{
	ARG_UNUSED(arg);
	bool is_compare_event = false;

	int err = my_rtc_get_compare_event(2, 1, &is_compare_event);
	
	if (err == 0 && is_compare_event) {
		my_rtc_clear_compare_event(2, 1);
		
		// clear counter to make it periodic (4-second interval)
		my_rtc_clear(2);
		my_rtc_start_compare(2, 1, 32);

		// Zephyr workqueue
		k_work_submit(&rtc_work);
	}
}
static inline zb_uint8_t hex_char_to_val(char c)
{
	if (c >= '0' && c <= '9') return c - '0';
	if (c >= 'a' && c <= 'f') return 10 + (c - 'a');
	if (c >= 'A' && c <= 'F') return 10 + (c - 'A');
	return 0;
}

static inline zb_uint8_t hex_pair_to_byte(const char *hex)
{
	return (hex_char_to_val(hex[0]) << 4) | hex_char_to_val(hex[1]);
}

static struct k_timer reboot_timer;

static void reboot_timer_handler(struct k_timer *dummy)
{
	sys_reboot(SYS_REBOOT_COLD);
}

static void factory_reset_handler(zb_bufid_t bufid)
{
	ARG_UNUSED(bufid);
	zb_bdb_reset_via_local_action(0);
	k_timer_init(&reboot_timer, reboot_timer_handler, NULL);
	k_timer_start(&reboot_timer, K_MSEC(1000), K_FOREVER);
}

static struct {
	zb_ieee_addr_t addr;
	zb_uint8_t ic[18];
} g_ic_set_params;

static void ic_set_callback(zb_bufid_t bufid)
{
	/* Note: do NOT call zb_set_long_address here.
	 * The device uses its own factory-burned IEEE address from FICR.
	 * We only set the Install Code for the TCLK derivation. */
	zb_ret_t status = zb_secur_ic_set(ZB_IC_TYPE_128, g_ic_set_params.ic);
	if (status == RET_OK) {
		printk("ic_set_success\n");
	} else {
		printk("ic_set_failed: %d\n", status);
	}
}

static void join_callback(zb_bufid_t bufid)
{
	zb_bool_t comm_status = bdb_start_top_level_commissioning(ZB_BDB_NETWORK_STEERING);
	if (comm_status) {
		printk("join_started\n");
	} else {
		printk("join_failed_busy\n");
	}
}

static void reboot_handler(zb_bufid_t bufid)
{
	ARG_UNUSED(bufid);
	sys_reboot(SYS_REBOOT_COLD);
}

static void parse_uart_command(char *line)
{
	printk("Parsed UART Command: '%s'\n", line);
	if (strncmp(line, "ic_set ", 7) == 0) {
		const char *ieee_hex = &line[7];
		const char *ic_hex = &line[24]; // 7 + 16 + 1 (space)

		if (line[23] != ' ' || strlen(ieee_hex) < 53) {
			printk("ic_set_failed: invalid format\n");
			return;
		}

		for (int i = 0; i < 8; i++) {
			g_ic_set_params.addr[7 - i] = hex_pair_to_byte(&ieee_hex[i * 2]);
		}

		for (int i = 0; i < 18; i++) {
			g_ic_set_params.ic[i] = hex_pair_to_byte(&ic_hex[i * 2]);
		}

		ZB_SCHEDULE_APP_CALLBACK(ic_set_callback, 0);
	} else if (strcmp(line, "join") == 0) {
		ZB_SCHEDULE_APP_CALLBACK(join_callback, 0);
	} else if (strcmp(line, "factory_reset") == 0) {
		printk("factory_reset_started\n");
		ZB_SCHEDULE_APP_CALLBACK(factory_reset_handler, 0);
	} else if (strcmp(line, "reboot") == 0) {
		printk("reboot_started\n");
		ZB_SCHEDULE_APP_CALLBACK(reboot_handler, 0);
	} else if (strcmp(line, "ieee") == 0) {
		zb_ieee_addr_t self_ieee;
		zb_get_long_address(self_ieee);
		printk("Device IEEE Address: %02x%02x%02x%02x%02x%02x%02x%02x\n",
		       self_ieee[7], self_ieee[6], self_ieee[5], self_ieee[4],
		       self_ieee[3], self_ieee[2], self_ieee[1], self_ieee[0]);
	}
}

#define UART_THREAD_STACK_SIZE 2048
#define UART_THREAD_PRIORITY 10

static void uart_rx_thread(void *p1, void *p2, void *p3)
{
	ARG_UNUSED(p1);
	ARG_UNUSED(p2);
	ARG_UNUSED(p3);

	printk("UART RX Thread: Initializing console...\n");
	console_getline_init();
	printk("UART RX Thread: Console initialized successfully.\n");

	while (1) {
		char *line = console_getline();
		if (line) {
			parse_uart_command(line);
		}
		k_msleep(20);
	}
}

K_THREAD_DEFINE(uart_rx_tid, UART_THREAD_STACK_SIZE,
                uart_rx_thread, NULL, NULL, NULL,
                UART_THREAD_PRIORITY, 0, 2000);

int main(void)
{
	LOG_INF("Starting ZBOSS BMP180 Temperature Sensor");


	/* Initialize. */
	configure_gpio();
	register_factory_reset_button(FACTORY_RESET_BUTTON);

	bmp180_init();

	zigbee_erase_persistent_storage(ERASE_PERSISTENT_CONFIG);
	zb_set_ed_timeout(ED_AGING_TIMEOUT_64MIN);
	zb_set_keepalive_timeout(ZB_MILLISECONDS_TO_BEACON_INTERVAL(3000));


	/* If "sleepy button" is defined, check its state during Zigbee
	 * initialization and enable sleepy behavior at device if defined button
	 * is pressed.
	 */
	
	#if defined BUTTON_SLEEPY
	if (dk_get_buttons() & BUTTON_SLEEPY) {
		zigbee_configure_sleepy_behavior(true);
	}
	#endif

	/* Power off unused sections of RAM to lower device power consumption. */
	if (IS_ENABLED(CONFIG_RAM_POWER_DOWN_LIBRARY)) {
		power_down_unused_ram();
	}

	/* Register sensor device context (endpoints). */
	ZB_AF_REGISTER_DEVICE_CTX(&bmp180_sensor_ctx);

	app_clusters_attr_init();




	#if defined(CONFIG_LIGHT_SWITCH_CONFIGURE_TX_POWER)
		set_tx_power();
	#endif /* CONFIG_LIGHT_SWITCH_CONFIGURE_TX_POWER */



	/* Start Zigbee default thread. */
	zigbee_enable();

	zb_ieee_addr_t self_ieee;
	zb_get_long_address(self_ieee);
	LOG_INF("Device IEEE Address: %02x%02x%02x%02x%02x%02x%02x%02x",
	        self_ieee[7], self_ieee[6], self_ieee[5], self_ieee[4],
	        self_ieee[3], self_ieee[2], self_ieee[1], self_ieee[0]);

	LOG_INF("ZBOSS BMP180 Temperature Sensor started");

	if (my_timer_init(MY_TIMER_1, 4) != 0) {
		LOG_ERR("Failed to initialize TIMER1");
	}
	if (my_timer_start(MY_TIMER_1) != 0) {
		LOG_ERR("Failed to start TIMER1");
	}

	k_work_init(&rtc_work, rtc_work_handler);

	if (my_rtc_init(2, 4095) != 0) { // 125 ms / tick
		LOG_ERR("Failed to initialize RTC2");
	}
	if (my_rtc_start_compare(2, 1, 32) != 0) { // 32 ticks = 4 seconds
		LOG_ERR("Failed to set RTC2 compare value");
	}
	if (my_rtc_enable_interrupt(2, MY_RTC_INT_COMPARE1_MASK) != 0) {
		LOG_ERR("Failed to enable RTC2 interrupt mask");
	}

	// Enable the RTC2 interrupt in the NVIC
	IRQ_CONNECT(RTC2_IRQn, 2, rtc2_isr, NULL, 0);
	irq_enable(RTC2_IRQn);

	if (my_rtc_start(2) != 0) {
		LOG_ERR("Failed to start RTC2");
	}
	
	k_msleep(10);

	while (1) {
		k_sleep(K_FOREVER);
	}

}
```

## include/bmp_180.h
```c
#ifndef BMP_180_H
#define BMP_180_H

#include <stdint.h>
#include <stdbool.h>

typedef struct {
    int16_t  ac1;
    int16_t  ac2;
    int16_t  ac3;
    uint16_t ac4;
    uint16_t ac5;
    uint16_t ac6;
    int16_t  b1;
    int16_t  b2;
    int16_t  mb;
    int16_t  mc;
    int16_t  md;
} bmp180_calib_t;

/**
 * @brief Initialize the BMP180 sensor over I2C and load calibration data.
 *
 * @return 0 on success, or a negative error code on failure.
 */
int bmp180_init(void);

/**
 * @brief Read a compensated temperature from the BMP180 sensor.
 *
 * @param[out] temp_out Temperature in tenths of a degree Celsius (e.g. 150 = 15.0 C).
 * @return 0 on success, or a negative error code on failure.
 */
int bmp180_read_temperature(int32_t *temp_out);

/**
 * @brief Compute compensated temperature from a raw ADC value and calibration data.
 *
 * This is a pure mathematical function with no hardware dependencies.
 * Implements the BMP180 datasheet formula (section 3.5).
 *
 * @param[in]  UT   Raw uncompensated temperature ADC value.
 * @param[in]  cal  Pointer to calibration coefficients.
 * @param[out] temp_out Compensated temperature in tenths of a degree Celsius.
 * @return 0 on success, -EINVAL if cal or temp_out is NULL, -EDOM on division by zero.
 */
int bmp180_compute_temperature(int32_t UT, const bmp180_calib_t *cal, int32_t *temp_out);

#endif /* BMP_180_H */
```

## src/bmp180_math.c
```c
#include "bmp_180.h"
#include <stddef.h>
#include <errno.h>

int bmp180_compute_temperature(int32_t UT, const bmp180_calib_t *cal, int32_t *temp_out)
{
    if (cal == NULL || temp_out == NULL) {
        return -EINVAL;
    }

    int32_t X1 = (UT - (int32_t)cal->ac6) * (int32_t)cal->ac5 / (1 << 15);
    int32_t divisor = X1 + (int32_t)cal->md;

    if (divisor == 0) {
        return -EDOM;
    }

    int32_t X2 = ((int32_t)cal->mc * (1 << 11)) / divisor;
    int32_t B5 = X1 + X2;

    *temp_out = (B5 + 8) / (1 << 4);
    return 0;
}
```

## src/bmp_180.c
```c
#include "bmp_180.h"
#include <zephyr/kernel.h>
#include <zephyr/device.h>
#include <zephyr/drivers/i2c.h>
#include <zephyr/logging/log.h>
#include <errno.h>

LOG_MODULE_REGISTER(bmp180, LOG_LEVEL_INF);

#define BMP180_I2C_ADDR   0x77
#define BMP180_REG_CALIB  0xAA
#define BMP180_REG_CTRL   0xF4
#define BMP180_CMD_TEMP   0x2E
#define BMP180_REG_DATA   0xF6
#define BMP180_CALIB_LEN  22

static const struct device *i2c_dev = DEVICE_DT_GET(DT_NODELABEL(i2c0));
static bmp180_calib_t calib_data;
static bool is_calibrated = false;

int bmp180_init(void)
{
#if defined(CONFIG_BMP180_DEVICE_TEST_MODE)
    LOG_INF("[TEST MODE] Mocked calibration data loaded");
    is_calibrated = true;
    return 0;
#endif

    if (!device_is_ready(i2c_dev)) {
        LOG_ERR("I2C device i2c0 not ready");
        return -ENODEV;
    }

    uint8_t calib_reg = BMP180_REG_CALIB;
    uint8_t raw[BMP180_CALIB_LEN];
    int ret = i2c_write_read(i2c_dev, BMP180_I2C_ADDR, &calib_reg, 1, raw, BMP180_CALIB_LEN);
    if (ret < 0) {
        LOG_ERR("Failed to read calibration data (err %d)", ret);
        return ret;
    }

    calib_data.ac1 = (raw[ 0] << 8) | raw[ 1];
    calib_data.ac2 = (raw[ 2] << 8) | raw[ 3];
    calib_data.ac3 = (raw[ 4] << 8) | raw[ 5];
    calib_data.ac4 = (raw[ 6] << 8) | raw[ 7];
    calib_data.ac5 = (raw[ 8] << 8) | raw[ 9];
    calib_data.ac6 = (raw[10] << 8) | raw[11];
    calib_data.b1  = (raw[12] << 8) | raw[13];
    calib_data.b2  = (raw[14] << 8) | raw[15];
    calib_data.mb  = (raw[16] << 8) | raw[17];
    calib_data.mc  = (raw[18] << 8) | raw[19];
    calib_data.md  = (raw[20] << 8) | raw[21];

    LOG_INF("BMP180 calibration data loaded");
    is_calibrated = true;
    return 0;
}


int bmp180_read_temperature(int32_t *temp_out)
{
    if (temp_out == NULL) {
        return -EINVAL;
    }

#if defined(CONFIG_BMP180_DEVICE_TEST_MODE)
    static int32_t mock_temp = 200;
    *temp_out = mock_temp;
    LOG_INF("[TEST MODE] Mocked temperature: %d.%d C", *temp_out / 10, *temp_out % 10);
    mock_temp += 5;
    if (mock_temp > 300) {
        mock_temp = 200;
    }
    return 0;
#endif

    if (!is_calibrated) {
        int ret = bmp180_init();
        if (ret < 0) {
            return ret;
        }
    }

    if (!device_is_ready(i2c_dev)) {
        LOG_ERR("I2C device not ready");
        return -ENODEV;
    }

    uint8_t cmd[2] = {BMP180_REG_CTRL, BMP180_CMD_TEMP};
    int ret = i2c_write(i2c_dev, cmd, sizeof(cmd), BMP180_I2C_ADDR);
    if (ret < 0) {
        LOG_ERR("Failed to send temperature command (err %d)", ret);
        return ret;
    }

    k_msleep(5);

    uint8_t data_reg = BMP180_REG_DATA;
    uint8_t raw[2];
    ret = i2c_write_read(i2c_dev, BMP180_I2C_ADDR, &data_reg, 1, raw, 2);
    if (ret < 0) {
        LOG_ERR("Failed to read temperature register (err %d)", ret);
        return ret;
    }

    int32_t UT = (int32_t)((raw[0] << 8) | raw[1]);

    ret = bmp180_compute_temperature(UT, &calib_data, temp_out);
    if (ret < 0) {
        LOG_ERR("Temperature computation failed (err %d)", ret);
        return ret;
    }

    LOG_INF("Temperature: %d.%d C", *temp_out / 10, *temp_out % 10);
    return 0;
}
```
