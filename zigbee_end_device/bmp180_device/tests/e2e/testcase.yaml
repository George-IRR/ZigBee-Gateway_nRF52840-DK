## zigbee_end_device/bmp180_device/tests/e2e/testcase.yaml
```yaml
tests:
  bmp180.e2e.communication:
    tags: bmp180 sensor e2e zigbee
    harness: pytest
    timeout: 180
    platform_allow:
      - nrf52840dk/nrf52840
    integration_platforms:
      - nrf52840dk/nrf52840
```

## zigbee_end_device/bmp180_device/tests/integration/testcase.yaml
```yaml
tests:
  bmp180.integration.hardware:
    tags: bmp180 sensor integration i2c
    platform_allow:
      - nrf52840dk/nrf52840
    integration_platforms:
      - nrf52840dk/nrf52840
    harness: ztest
```
