## CMakeLists.txt
```
#
# Copyright (c) 2020 Nordic Semiconductor ASA
#
# SPDX-License-Identifier: LicenseRef-Nordic-5-Clause
#

cmake_minimum_required(VERSION 3.20.0)

set(BOARD_FLASH_RUNNER nrfutil)
find_package(Zephyr REQUIRED HINTS $ENV{ZEPHYR_BASE})

project(light_switch)

# NORDIC SDK APP START
target_sources(app PRIVATE
  src/main.c
  src/my_nrf52_timer.c
  src/bmp_180.c
  src/my_rtc.c
)

target_include_directories(app PRIVATE include)
# NORDIC SDK APP END

target_sources_ifdef(CONFIG_BT_NUS app PRIVATE
  src/nus_cmd.c
)
```

## prj.conf
```kconfig
#
# Copyright (c) 2020 Nordic Semiconductor ASA
#
# SPDX-License-Identifier: LicenseRef-Nordic-5-Clause
#

CONFIG_NCS_SAMPLES_DEFAULTS=y

CONFIG_UART_INTERRUPT_DRIVEN=y
CONFIG_SERIAL=y
CONFIG_GPIO=y

# Enable / disable asserts
CONFIG_ASSERT=y

# Make sure printk is not printing to the UART console
CONFIG_CONSOLE=y
CONFIG_UART_CONSOLE=y

CONFIG_HEAP_MEM_POOL_SIZE=2048

CONFIG_ZIGBEE=y
CONFIG_ZIGBEE_APP_UTILS=y
CONFIG_ZIGBEE_ROLE_END_DEVICE=y

# Enable DK LED and Buttons library
CONFIG_DK_LIBRARY=y

# This example requires more workqueue stack
CONFIG_SYSTEM_WORKQUEUE_STACK_SIZE=2048

# Enable API for powering down unused RAM parts
CONFIG_RAM_POWER_DOWN_LIBRARY=y

# Networking
CONFIG_NET_IPV6=n
CONFIG_NET_IP_ADDR_CHECK=n
CONFIG_NET_UDP=n


CONFIG_I2C=y
CONFIG_SENSOR=y
```

## include/bmp_180.h
```c
#ifndef BMP_180_H
#define BMP_180_H

#include <stdint.h>

/**
 * @brief Initialize the BMP180 sensor.
 * 
 * @return 0 on success, or a negative error code on failure.
 */
int bmp180_init(void);

/**
 * @brief Read the temperature from the BMP180 sensor.
 * 
 * @return The temperature in tenths of a degree Celsius (e.g. 254 for 25.4°C),
 *         or 0 if reading fails.
 */
int bmp180_read_temperature(int32_t *temp_out);

#endif // BMP_180_H
```

## include/my_nrf52_timer.h
```c
#ifndef MY_NRF52_TIMER_H
#define MY_NRF52_TIMER_H

#include <stdint.h>

typedef struct {
    volatile uint32_t TASKS_START;      // Offset 0x000
    volatile uint32_t TASKS_STOP;       // Offset 0x004

    uint32_t RESERVED0[14];             // 0x008 - 0x03F

    volatile uint32_t TASKS_CAPTURE0;   // Offset 0x040
    volatile uint32_t TASKS_CAPTURE1;   // Offset 0x044
    volatile uint32_t TASKS_CAPTURE2;   // Offset 0x048
    volatile uint32_t TASKS_CAPTURE3;   // Offset 0x04C
    volatile uint32_t TASKS_CAPTURE4;   // Offset 0x050
    volatile uint32_t TASKS_CAPTURE5;   // Offset 0x054
    
    uint32_t RESERVED1[300];            // 0x058 - 0x507
    
    volatile uint32_t BITMODE;          // Offset 0x508
    volatile uint32_t MODE;             // Offset 0x50C
    volatile uint32_t PRESCALER;        // Offset 0x510

    uint32_t RESERVED3[11];             // 0x514 - 0x53F

    volatile uint32_t CC0;              // Offset 0x540
    volatile uint32_t CC1;              // Offset 0x544
    volatile uint32_t CC2;              // Offset 0x548
    volatile uint32_t CC3;              // Offset 0x54C
    volatile uint32_t CC4;              // Offset 0x550
    volatile uint32_t CC5;              // Offset 0x554
} My_TIMER_Type;

#define TIMER0_BASE     (0x40008000UL)
#define TIMER1_BASE     (0x40009000UL)
#define TIMER2_BASE     (0x4000A000UL)
#define TIMER3_BASE     (0x4001A000UL)
#define TIMER4_BASE     (0x4001B000UL)

#define MY_TIMER0      ((My_TIMER_Type *) TIMER0_BASE)
#define MY_TIMER1      ((My_TIMER_Type *) TIMER1_BASE)
#define MY_TIMER2      ((My_TIMER_Type *) TIMER2_BASE)
#define MY_TIMER3      ((My_TIMER_Type *) TIMER3_BASE)
#define MY_TIMER4      ((My_TIMER_Type *) TIMER4_BASE)

typedef enum {
    MY_TIMER_0 = 0,
    MY_TIMER_1,
    MY_TIMER_2,
    MY_TIMER_3,
    MY_TIMER_4
} my_timer_instance_t;

int my_timer_init(my_timer_instance_t timer_idx, uint8_t prescaler);
int my_timer_start(my_timer_instance_t timer_idx);
int my_timer_stop(my_timer_instance_t timer_idx);
int my_timer_get_value(my_timer_instance_t timer_idx, uint8_t channel, uint32_t *out_value);

#endif // MY_NRF52_TIMER_H
```

## include/my_rtc.h
```c
#ifndef MY_RTC_H
#define MY_RTC_H

#include <stdint.h>
#include <stdbool.h>

typedef struct {
    volatile uint32_t TASKS_START;      // 0x000
    volatile uint32_t TASKS_STOP;       // 0x004
    volatile uint32_t TASKS_CLEAR;      // 0x008
    volatile uint32_t TASKS_TRIGOVRFLW; // 0x00C
    
    uint32_t RESERVED0[60];             
    
    volatile uint32_t EVENTS_TICK;      // 0x100
    volatile uint32_t EVENTS_OVRFLW;    // 0x104
    
    uint32_t RESERVED1[14];             
    
    volatile uint32_t EVENTS_COMPARE[4];// 0x140
    
    uint32_t RESERVED2[109];            
    
    volatile uint32_t INTENSET;         // 0x304
    volatile uint32_t INTENCLR;         // 0x308
    
    uint32_t RESERVED3[13];             
    
    volatile uint32_t EVTEN;            // 0x340
    volatile uint32_t EVTENSET;         // 0x344
    volatile uint32_t EVTENCLR;         // 0x348
    
    uint32_t RESERVED4[110];            
    
    volatile uint32_t COUNTER;          // 0x504
    volatile uint32_t PRESCALER;        // 0x508
    
    uint32_t RESERVED5[13];             
    
    volatile uint32_t CC[4];            // 0x540
} My_RTC_Type;

#define MY_RTC0  ((My_RTC_Type *) 0x4000B000)
#define MY_RTC1  ((My_RTC_Type *) 0x40011000)
#define MY_RTC2  ((My_RTC_Type *) 0x40024000)

typedef enum {
    MY_RTC_0 = 0,
    MY_RTC_1,
    MY_RTC_2
} my_rtc_instance_t;

int my_rtc_init(my_rtc_instance_t rtc_idx, uint16_t prescaler);
int my_rtc_start(my_rtc_instance_t rtc_idx);
int my_rtc_stop(my_rtc_instance_t rtc_idx);
int my_rtc_clear(my_rtc_instance_t rtc_idx);
int my_rtc_get_value(my_rtc_instance_t rtc_idx, uint32_t *out_value);
int my_rtc_start_compare(my_rtc_instance_t rtc_idx, uint8_t channel, uint32_t compare_value);
int my_rtc_get_compare_event(my_rtc_instance_t rtc_idx, uint8_t channel, bool *out_event);
int my_rtc_clear_compare_event(my_rtc_instance_t rtc_idx, uint8_t channel);
int my_rtc_enable_interrupt(my_rtc_instance_t rtc_idx, uint32_t mask);
int my_rtc_disable_interrupt(my_rtc_instance_t rtc_idx, uint32_t mask);

#define MY_RTC_INT_TICK_MASK      (1UL << 0)
#define MY_RTC_INT_OVRFLW_MASK    (1UL << 1)
#define MY_RTC_INT_COMPARE0_MASK  (1UL << 16)
#define MY_RTC_INT_COMPARE1_MASK  (1UL << 17)
#define MY_RTC_INT_COMPARE2_MASK  (1UL << 18)
#define MY_RTC_INT_COMPARE3_MASK  (1UL << 19)

#endif // MY_RTC_H
```

## src/bmp_180.c
```c
#include "bmp_180.h"
#include <zephyr/kernel.h>
#include <zephyr/device.h>
#include <zephyr/drivers/i2c.h>
#include <zephyr/logging/log.h>
#include <errno.h>

LOG_MODULE_REGISTER(bmp180, LOG_LEVEL_INF);

#define BMP180_I2C_ADDR 0x77

typedef struct {
    int16_t  ac1;
    int16_t  ac2;
    int16_t  ac3;
    uint16_t ac4;
    uint16_t ac5;
    uint16_t ac6;
    int16_t  b1;
    int16_t  b2;
    int16_t  mb;
    int16_t  mc;
    int16_t  md;
} bmp180_calib_t;

static const struct device *i2c_dev = DEVICE_DT_GET(DT_NODELABEL(i2c0));
static bmp180_calib_t calib_data;
static bool is_calibrated = false;

int bmp180_init(void)
{
    if (!device_is_ready(i2c_dev)) {
        LOG_ERR("I2C device i2c0 not ready");
        return -ENODEV;
    }

    uint8_t calib_reg = 0xAA;
    uint8_t calib_read[22]; 
    int ret;
    
    ret = i2c_write_read(i2c_dev, BMP180_I2C_ADDR, &calib_reg, 1, calib_read, 22);
    if (ret < 0) {
        LOG_ERR("Failed to read calibration data from BMP180 (err %d)", ret);
        return ret;
    }

    calib_data.ac1 = (calib_read[0 ] << 8) | calib_read[1 ];
    calib_data.ac2 = (calib_read[2 ] << 8) | calib_read[3 ];
    calib_data.ac3 = (calib_read[4 ] << 8) | calib_read[5 ];
    calib_data.ac4 = (calib_read[6 ] << 8) | calib_read[7 ];
    calib_data.ac5 = (calib_read[8 ] << 8) | calib_read[9 ];
    calib_data.ac6 = (calib_read[10] << 8) | calib_read[11];
    calib_data.b1  = (calib_read[12] << 8) | calib_read[13];
    calib_data.b2  = (calib_read[14] << 8) | calib_read[15];
    calib_data.mb  = (calib_read[16] << 8) | calib_read[17];
    calib_data.mc  = (calib_read[18] << 8) | calib_read[19];
    calib_data.md  = (calib_read[20] << 8) | calib_read[21];
    
    LOG_INF("BMP180 Calibration Data Loaded Successfully.");
    is_calibrated = true;
    return 0;
}

// Returnează 0 la succes, sau un cod negativ la eroare
int bmp180_read_temperature(int32_t *temp_out)
{
    if (temp_out == NULL) {
        return -EINVAL; 
    }

    if (!is_calibrated) {
        LOG_INF("BMP180 not calibrated. Retrying calibration initialization...");
        int init_ret = bmp180_init();
        if (init_ret < 0) {
            return init_ret;
        }
    }

    if (!device_is_ready(i2c_dev)) {
        LOG_ERR("I2C device not ready during temp read");
        return -ENODEV; 
    }

    uint8_t reg_addr = 0xF4;
    uint8_t command = 0x2E;
    uint8_t buffer[2] = {reg_addr, command};
    int ret;

    ret = i2c_write(i2c_dev, buffer, 2, BMP180_I2C_ADDR);
    if (ret < 0) {
        LOG_ERR("Failed to write temperature readout command (err %d)", ret);
        return ret;
    }
    
    k_msleep(5);
    
    uint8_t ut_reg = 0xF6;
    uint8_t ut_buffer[2];
    ret = i2c_write_read(i2c_dev, BMP180_I2C_ADDR, &ut_reg, 1, ut_buffer, 2);
    if (ret < 0) {
        LOG_ERR("Failed to read temperature register (err %d)", ret);
        return ret;
    }

    int32_t UT = (int32_t)((ut_buffer[0] << 8) | ut_buffer[1]);

    int32_t X1, X2, B5, T;
    X1 = (UT - (int32_t)calib_data.ac6) * (int32_t)calib_data.ac5 / (1 << 15);
    
    int32_t divisor = X1 + (int32_t)calib_data.md;
    if (divisor == 0) {
        LOG_ERR("BMP180 division by zero (X1 + md = 0)!");
        return -EDOM;
    }
    X2 = ((int32_t)calib_data.mc * (1 << 11)) / divisor;
    B5 = X1 + X2;
    T = (B5 + 8) / (1 << 4);

    LOG_INF("Temperature: %d.%d C", T / 10, T % 10);
    
    *temp_out = T; 
    
    return 0; // Succes!
}
```

## src/my_nrf52_timer.c
```c
#include "my_nrf52_timer.h"
#include <zephyr/sys/__assert.h> 
#include <errno.h>

static My_TIMER_Type* get_timer_pointer(my_timer_instance_t timer_idx)
{
    switch (timer_idx) {
        case MY_TIMER_0: return MY_TIMER0;
        case MY_TIMER_1: return MY_TIMER1;
        case MY_TIMER_2: return MY_TIMER2;
        case MY_TIMER_3: return MY_TIMER3;
        case MY_TIMER_4: return MY_TIMER4;
        default:         return ((void*)0); 
    }
}

int my_timer_init(my_timer_instance_t timer_idx, uint8_t prescaler)
{
    My_TIMER_Type *timer = get_timer_pointer(timer_idx);
    __ASSERT(timer != NULL, "Invalid Timer instance!");
    if (!timer) {
        return -EINVAL;
    }
    
    timer->BITMODE   = 3;          // 32 bit configuration
    timer->PRESCALER = prescaler;  
    return 0;
}

int my_timer_start(my_timer_instance_t timer_idx)
{
    My_TIMER_Type *timer = get_timer_pointer(timer_idx);
    __ASSERT_NO_MSG(timer != NULL);
    if (!timer) {
        return -EINVAL;
    }
    
    timer->TASKS_START = 1;
    return 0;
}

int my_timer_stop(my_timer_instance_t timer_idx)
{
    My_TIMER_Type *timer = get_timer_pointer(timer_idx);
    __ASSERT_NO_MSG(timer != NULL);
    if (!timer) {
        return -EINVAL;
    }
    
    timer->TASKS_STOP = 1;
    return 0;
}

int my_timer_get_value(my_timer_instance_t timer_idx, uint8_t channel, uint32_t *out_value)
{
    My_TIMER_Type *timer = get_timer_pointer(timer_idx);
    __ASSERT(timer != NULL, "Invalid Timer instance!");
    __ASSERT(channel <= 5, "Invalid Timer channel!");
    __ASSERT(out_value != NULL, "Output pointer is NULL!");
    
    if (!timer || channel > 5 || !out_value) {
        return -EINVAL;
    }

    switch (channel) {
        case 0: timer->TASKS_CAPTURE0 = 1; *out_value = timer->CC0; break;
        case 1: timer->TASKS_CAPTURE1 = 1; *out_value = timer->CC1; break;
        case 2: timer->TASKS_CAPTURE2 = 1; *out_value = timer->CC2; break;
        case 3: timer->TASKS_CAPTURE3 = 1; *out_value = timer->CC3; break;
        case 4: timer->TASKS_CAPTURE4 = 1; *out_value = timer->CC4; break;
        case 5: timer->TASKS_CAPTURE5 = 1; *out_value = timer->CC5; break;
        default: return -EINVAL;
    }
    
    return 0;
}
```

## src/my_rtc.c
```c
#include <my_rtc.h>
#include <zephyr/sys/__assert.h> 
#include <errno.h>

static My_RTC_Type* get_rtc_pointer(my_rtc_instance_t rtc_idx)
{
    switch (rtc_idx) {
        case MY_RTC_0: return MY_RTC0;
        case MY_RTC_1: return MY_RTC1;
        case MY_RTC_2: return MY_RTC2;
        default:       return ((void*)0); 
    }
}

int my_rtc_init(my_rtc_instance_t rtc_idx, uint16_t prescaler)
{
    My_RTC_Type *rtc = get_rtc_pointer(rtc_idx);
    __ASSERT(rtc != NULL, "Invalid RTC instance!");
    if (!rtc) {
        return -EINVAL;
    }

    rtc->PRESCALER = prescaler;
    rtc->TASKS_CLEAR = 1;
    return 0;
}

int my_rtc_start(my_rtc_instance_t rtc_idx)
{
    My_RTC_Type *rtc = get_rtc_pointer(rtc_idx);
    __ASSERT_NO_MSG(rtc != NULL);
    if (!rtc) {
        return -EINVAL;
    }

    rtc->TASKS_START = 1; 
    return 0;
}

int my_rtc_stop(my_rtc_instance_t rtc_idx)
{
    My_RTC_Type *rtc = get_rtc_pointer(rtc_idx);
    __ASSERT_NO_MSG(rtc != NULL);
    if (!rtc) {
        return -EINVAL;
    }

    rtc->TASKS_STOP = 1;
    return 0;
}

int my_rtc_clear(my_rtc_instance_t rtc_idx)
{
    My_RTC_Type *rtc = get_rtc_pointer(rtc_idx);
    __ASSERT_NO_MSG(rtc != NULL);
    if (!rtc) {
        return -EINVAL;
    }

    rtc->TASKS_CLEAR = 1;
    return 0;
}

int my_rtc_get_value(my_rtc_instance_t rtc_idx, uint32_t *out_value)
{
    My_RTC_Type *rtc = get_rtc_pointer(rtc_idx);
    __ASSERT(rtc != NULL, "Invalid RTC instance!");
    __ASSERT(out_value != NULL, "Output pointer is NULL!");
    
    if (!rtc || !out_value) {
        return -EINVAL;
    }

    *out_value = rtc->COUNTER;
    return 0;
}

int my_rtc_start_compare(my_rtc_instance_t rtc_idx, uint8_t channel, uint32_t compare_value)
{
    My_RTC_Type *rtc = get_rtc_pointer(rtc_idx);
    
    __ASSERT(rtc != NULL, "Invalid RTC instance!");
    __ASSERT(channel <= 3, "Invalid RTC channel!");
    __ASSERT(compare_value <= 0x00FFFFFF, "CC value exceeds 24-bit resolution!");

    if (!rtc || channel > 3 || compare_value > 0x00FFFFFF) {
        return -EINVAL;
    }

    rtc->CC[channel] = compare_value;
    rtc->EVTENSET = (1 << (16 + channel));
    return 0;
}

int my_rtc_get_compare_event(my_rtc_instance_t rtc_idx, uint8_t channel, bool *out_event)
{
    My_RTC_Type *rtc = get_rtc_pointer(rtc_idx);
    __ASSERT(rtc != NULL, "Invalid RTC instance!");
    __ASSERT(channel <= 3, "Invalid RTC channel!");
    __ASSERT(out_event != NULL, "Output pointer is NULL!");
    
    if (!rtc || channel > 3 || !out_event) {
        return -EINVAL;
    }

    *out_event = (rtc->EVENTS_COMPARE[channel] == 1);
    return 0;
}

int my_rtc_clear_compare_event(my_rtc_instance_t rtc_idx, uint8_t channel)
{
    My_RTC_Type *rtc = get_rtc_pointer(rtc_idx);
    __ASSERT(rtc != NULL, "Invalid RTC instance!");
    __ASSERT(channel <= 3, "Invalid RTC channel!");
    
    if (!rtc || channel > 3) {
        return -EINVAL;
    }

    rtc->EVENTS_COMPARE[channel] = 0;
    return 0;
}

int my_rtc_enable_interrupt(my_rtc_instance_t rtc_idx, uint32_t mask)
{
    My_RTC_Type *rtc = get_rtc_pointer(rtc_idx);
    __ASSERT_NO_MSG(rtc != NULL);
    if (!rtc) {
        return -EINVAL;
    }

    rtc->INTENSET = mask;
    return 0;
}

int my_rtc_disable_interrupt(my_rtc_instance_t rtc_idx, uint32_t mask)
{
    My_RTC_Type *rtc = get_rtc_pointer(rtc_idx);
    __ASSERT_NO_MSG(rtc != NULL);
    if (!rtc) {
        return -EINVAL;
    }

    rtc->INTENCLR = mask;
    return 0;
}
```
